## zephyr/Kconfig
```kconfig
# Copyright Notice:
# Copyright 2026 DMTF. All rights reserved.
# License: BSD 3-Clause License.

menuconfig LIBSPDM
	bool "libspdm: DMTF SPDM library"
	help
	  Enable the libspdm reference implementation of DMTF SPDM
	  (Security Protocol and Data Model). When enabled, the libspdm
	  static library is built and made available to the application.

if LIBSPDM

config LIBSPDM_REQUESTER
	bool "Build SPDM requester role"
	default y

config LIBSPDM_RESPONDER
	bool "Build SPDM responder role"
	default y

choice LIBSPDM_CRYPTO_BACKEND
	prompt "Crypto backend"
	default LIBSPDM_CRYPTO_MBEDTLS

config LIBSPDM_CRYPTO_MBEDTLS
	bool "mbedTLS (Zephyr module)"
	select MBEDTLS
	help
	  Use Zephyr's mbedTLS module as the libspdm crypto backend.
	  See zephyr/Kconfig.mbedtls for the additional mbedTLS
	  features auto-selected by this option.

config LIBSPDM_CRYPTO_NULL
	bool "Null crypto (compile-only, will fail at runtime)"

endchoice

config LIBSPDM_SECRET_LIB_SAMPLE
	bool "Build the sample device-secret library"
	default y
	help
	  Builds os_stub/spdm_device_secret_lib_sample. On Zephyr the
	  file-based key/cert loader is replaced by an embedded-blob
	  registry (see libspdm/zephyr/include/libspdm/zephyr/secret_blob.h);
	  the application is responsible for registering the blobs at
	  startup.

menu "Transports"

config LIBSPDM_TRANSPORT_MCTP
	bool "MCTP transport binding"
	default y

config LIBSPDM_TRANSPORT_MCTP_LIBMCTP_BRIDGE
	bool "Bridge libspdm MCTP transport to Zephyr libmctp"
	depends on LIBSPDM_TRANSPORT_MCTP
	depends on MCTP
	default y if MCTP
	help
	  Build the spdm_mctp_io bridge (zephyr/src/spdm_mctp_io.c).
	  The bridge implements libspdm's device_send_message /
	  device_receive_message / buffer hooks on top of a Zephyr
	  libmctp instance. The application is still responsible for
	  creating the libmctp context, registering a binding (I3C,
	  I2C, serial, ...), and pairing the bridge with the libspdm
	  context.

config LIBSPDM_MCTP_BUFFER_SIZE
	int "MCTP transport buffer size (bytes)"
	depends on LIBSPDM_TRANSPORT_MCTP_LIBMCTP_BRIDGE
	default 4224
	help
	  Size of the sender and receiver buffers owned by each
	  spdm_mctp_io instance. Must fit the largest SPDM transport
	  message (SPDM payload + the 1-byte MCTP message-type byte
	  + transport alignment). 4224 is large enough for the
	  default LIBSPDM_DATA_TRANSFER_SIZE of 4096 plus headroom.

config LIBSPDM_MCTP_RX_QUEUE_DEPTH
	int "MCTP RX queue depth"
	depends on LIBSPDM_TRANSPORT_MCTP_LIBMCTP_BRIDGE
	default 2
	range 1 8
	help
	  Number of in-flight RX slots between the libmctp rx
	  callback and device_receive_message(). One is enough for
	  strict request/response traffic; raise it if the dispatcher
	  may briefly fall behind the producer.

config LIBSPDM_MCTP_MAX_BRIDGES
	int "Maximum number of bridged libspdm contexts"
	depends on LIBSPDM_TRANSPORT_MCTP_LIBMCTP_BRIDGE
	default 2
	range 1 8
	help
	  Upper bound on the number of (spdm_context, spdm_mctp_io)
	  associations the bridge can track at once. 2 covers a single
	  app that drives one requester and one responder; raise this
	  if you bridge more than that.

module = LIBSPDM_MCTP
module-str = libspdm MCTP bridge
source "subsys/logging/Kconfig.template.log_config"

config LIBSPDM_TRANSPORT_PCI_DOE
	bool "PCI DOE transport binding"

config LIBSPDM_TRANSPORT_TCP
	bool "TCP transport binding"

config LIBSPDM_TRANSPORT_STORAGE
	bool "Storage transport binding"

endmenu

menu "Debug"

config LIBSPDM_DEBUG_ENABLE
	bool "Enable libspdm debug prints and asserts"
	default y if DEBUG

config LIBSPDM_DEBUG_BLOCK_ON_ASSERT
	bool "Block in libspdm_debug_assert (else __ASSERT)"
	depends on LIBSPDM_DEBUG_ENABLE

endmenu

config LIBSPDM_MAX_SESSION_COUNT
	int "Maximum concurrent SPDM sessions"
	default 4
	range 1 16

config LIBSPDM_MAX_CERT_CHAIN_SIZE
	int "Maximum certificate chain size (bytes)"
	default 4096

# mbedTLS feature requirements pulled in when LIBSPDM_CRYPTO_MBEDTLS=y.
rsource "Kconfig.mbedtls"

endif # LIBSPDM
```
